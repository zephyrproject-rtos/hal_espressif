## zephyr/Kconfig
```kconfig
# Copyright (c) 2024-2025 Espressif Systems (Shanghai) Co., Ltd.
# SPDX-License-Identifier: Apache-2.0

if SOC_FAMILY_ESPRESSIF_ESP32

# ESP-IDF platform marker - enables ESP-IDF-specific code paths
config ESP_PLATFORM
	bool
	default y

# Include SoC capabilities from ESP-IDF soc component
# These define CONFIG_SOC_* options based on hardware capabilities
if SOC_SERIES_ESP32
rsource "../components/soc/esp32/include/soc/Kconfig.soc_caps.in"
endif

if SOC_SERIES_ESP32S2
rsource "../components/soc/esp32s2/include/soc/Kconfig.soc_caps.in"
endif

if SOC_SERIES_ESP32S3
rsource "../components/soc/esp32s3/include/soc/Kconfig.soc_caps.in"
endif

if SOC_SERIES_ESP32C2
rsource "../components/soc/esp32c2/include/soc/Kconfig.soc_caps.in"
endif

if SOC_SERIES_ESP32C3
rsource "../components/soc/esp32c3/include/soc/Kconfig.soc_caps.in"
endif

if SOC_SERIES_ESP32C5
rsource "../components/soc/esp32c5/include/soc/Kconfig.soc_caps.in"
endif

if SOC_SERIES_ESP32C6
rsource "../components/soc/esp32c6/include/soc/Kconfig.soc_caps.in"
endif

if SOC_SERIES_ESP32H2
rsource "../components/soc/esp32h2/include/soc/Kconfig.soc_caps.in"
endif

if SOC_SERIES_ESP32P4
rsource "../components/soc/esp32p4/include/soc/Kconfig.soc_caps.in"
endif

# XTAL frequency in Hz from devicetree
config XTAL_FREQ_HZ
	int
	default $(dt_node_int_prop_int,/cpus/cpu@0,xtal-freq)

# XTAL frequency in MHz for ESP-IDF components
config XTAL_FREQ
	int
	default 26 if XTAL_FREQ_HZ = 26000000
	default 32 if XTAL_FREQ_HZ = 32000000
	default 40 if XTAL_FREQ_HZ = 40000000
	default 48 if XTAL_FREQ_HZ = 48000000

# XTAL frequency selection flags for ESP-IDF
config XTAL_FREQ_26
	bool
	default y if XTAL_FREQ = 26

config XTAL_FREQ_32
	bool
	default y if XTAL_FREQ = 32

config XTAL_FREQ_40
	bool
	default y if XTAL_FREQ = 40

config XTAL_FREQ_48
	bool
	default y if XTAL_FREQ = 48

config BOOTLOADER_OFFSET_IN_FLASH
	hex
	default $(dt_node_reg_addr_hex,$(dt_nodelabel_path,boot_partition))

config BOOTLOADER_CPU_CLK_FREQ_MHZ
	int
	default 64 if SOC_SERIES_ESP32H2
	default 100 if SOC_SERIES_ESP32P4
	default 80

config ESP_SYSTEM_RTC_EXT_XTAL_BOOTSTRAP_CYCLES
	int "Bootstrap cycles for external 32kHz crystal"
	depends on CLOCK_CONTROL_ESP32_RTC_CLK_SRC_EXT_CRYS
	default 5 if SOC_SERIES_ESP32
	default 0
	range 0 32768
	help
	  To reduce the startup time of an external RTC crystal,
	  we bootstrap it with a 32kHz square wave for a fixed number of cycles.
	  Setting 0 will disable bootstrapping (if disabled, the crystal may take
	  longer to start up or fail to oscillate under some conditions).

	  If this value is too high, a faulty crystal may initially start and then fail.
	  If this value is too low, an otherwise good crystal may not start.

	  To accurately determine if the crystal has started,
	  set a larger "Number of cycles for RTC_SLOW_CLK calibration" (about 3000).

# CPU frequency in MHz derived from devicetree clock-frequency property
config ESP_DEFAULT_CPU_FREQ_MHZ
	int
	default 96 if ESP_CLK_FREQ_HZ = 96000000
	default 120 if ESP_CLK_FREQ_HZ = 120000000
	default 160 if ESP_CLK_FREQ_HZ = 160000000
	default 240 if ESP_CLK_FREQ_HZ = 240000000
	default 400 if ESP_CLK_FREQ_HZ = 400000000

# CPU clock frequency in Hz from devicetree
config ESP_CLK_FREQ_HZ
	int
	default $(dt_node_int_prop_int,/cpus/cpu@0,clock-frequency)

# Console serial port number for ESP-IDF ROM functions.
# Set to -1 for USB Serial JTAG console (no UART TX wait needed).
config ESP_CONSOLE_ROM_SERIAL_PORT_NUM
	int
	default -1 if ESP_CONSOLE_USB_SERIAL_JTAG
	default ESP_CONSOLE_UART_NUM

# ESP timer interrupt level (only ESP32 supports 1-3, others only 1)
config ESP_TIMER_INTERRUPT_LEVEL
	int
	default 1
	range 1 3 if SOC_SERIES_ESP32
	range 1 1

config BOOTLOADER_LOG_LEVEL
	int
	default 3

config LOG_TIMESTAMP_SOURCE_RTOS
	bool
	default y

config ESP32_DPORT_DIS_INTERRUPT_LVL
	int
	default 5 if SOC_SERIES_ESP32 || SOC_SERIES_ESP32S3

config ESP_SYSTEM_SINGLE_CORE_MODE
	bool
	default y if !SMP

config IDF_TARGET_ARCH_RISCV
	bool
	default y if RISCV

config IDF_TARGET_ARCH_XTENSA
	bool
	default y if XTENSA

config SPI_FLASH_PLACE_FUNCTIONS_IN_IRAM
	bool
	default y

config ESP_SYSTEM_CHECK_INT_LEVEL_4
	bool
	default y if SOC_SERIES_ESP32

config ESP_PHY_ENABLED
	bool
	default y if (SOC_PHY_SUPPORTED)

# RF calibration data persistence. The esp_phy code checks
# CONFIG_ESP_PHY_CALIBRATION_AND_DATA_STORAGE to decide whether to load and
# store calibration data in NVS (partial calibration on warm boots) or run a
# full calibration on every boot. This symbol is not user-facing; it is
# derived from the generic RADIO_CAL feature so RADIO_CAL is the single knob.
config ESP_PHY_CALIBRATION_AND_DATA_STORAGE
	bool
	default y if RADIO_CAL

# Calibration intensity used when stored data is present: 0 = partial (the
# fast warm-boot path), 1 = none, 2 = full.
config ESP_PHY_CALIBRATION_MODE
	int
	default 0

config SOC_XTAL_FREQ_MHZ
	int
	default XTAL_FREQ if SOC_SERIES_ESP32C2

# FreeRTOS compatibility: number of processors
config portNUM_PROCESSORS
	int
	default SOC_CPU_CORES_NUM

config IDF_FIRMWARE_CHIP_ID
	hex
	default 0x0000 if SOC_SERIES_ESP32
	default 0x0002 if SOC_SERIES_ESP32S2
	default 0x0009 if SOC_SERIES_ESP32S3
	default 0x000C if SOC_SERIES_ESP32C2
	default 0x0005 if SOC_SERIES_ESP32C3
	default 0x0017 if SOC_SERIES_ESP32C5
	default 0x000D if SOC_SERIES_ESP32C6
	default 0x0010 if SOC_SERIES_ESP32H2
	default 0x0012 if SOC_SERIES_ESP32P4

config SPIRAM_ALLOW_BSS_SEG_EXTERNAL_MEMORY
	bool
	default y if SOC_SERIES_ESP32
	default y if SOC_SERIES_ESP32S2
	default y if SOC_SERIES_ESP32S3

config SPIRAM_ALLOW_NOINIT_SEG_EXTERNAL_MEMORY
	bool
	default y if SOC_SERIES_ESP32
	default y if SOC_SERIES_ESP32S2
	default y if SOC_SERIES_ESP32S3

config IDF_TARGET
	string
	default SOC

config PM_SLP_SPIRAM_HALFSLEEP_EXIT_WAIT_DELAY
	int
	default 150
	help
	  Delay in microseconds between waking PSRAM out of halfsleep
	  and the first access to it. Mirrors the ESP-IDF symbol of
	  the same name so HAL halfsleep recovery code compiles even
	  when PM is not enabled in the application.

config IDF_TARGET_ESP32
	bool
	default y if SOC_SERIES_ESP32

config IDF_TARGET_ESP32S2
	bool
	default y if SOC_SERIES_ESP32S2

config IDF_TARGET_ESP32S3
	bool
	default y if SOC_SERIES_ESP32S3

config IDF_TARGET_ESP32C2
	bool
	default y if SOC_SERIES_ESP32C2

config IDF_TARGET_ESP32C3
	bool
	default y if SOC_SERIES_ESP32C3

config IDF_TARGET_ESP32C5
	bool
	default y if SOC_SERIES_ESP32C5

config IDF_TARGET_ESP32C6
	bool
	default y if SOC_SERIES_ESP32C6

config IDF_TARGET_ESP32H2
	bool
	default y if SOC_SERIES_ESP32H2

config IDF_TARGET_ESP32P4
	bool
	default y if SOC_SERIES_ESP32P4

config ESP_TIMER_IMPL_TG0_LAC
	bool
	default y
	depends on IDF_TARGET_ESP32

config ESP_TIMER_IMPL_SYSTIMER
	bool
	default y
	depends on !SOC_SERIES_ESP32

menu "Wi-Fi config"

choice ESP_WIFI_TASK_CORE_ID
	prompt "WiFi Task Core ID"
	depends on SOC_SERIES_ESP32S3
	default ESP_WIFI_TASK_PINNED_TO_CORE_0
	help
	  Pinned WiFi task to core 0 or core 1.

config ESP_WIFI_TASK_PINNED_TO_CORE_0
	bool "Core 0"

config ESP_WIFI_TASK_PINNED_TO_CORE_1
	bool "Core 1"

endchoice # ESP_WIFI_TASK_CORE_ID

endmenu # Wi-Fi config

if BT_ESP32

config ESP32_BT_CTLR_PINNED_TO_CORE
	int
	default 0

endif

config ESP_ENABLE_PVT
	bool "Auto adjust hp & lp voltage using pvt function"
	depends on SOC_PMU_PVT_SUPPORTED
	default n if IDF_TARGET_ESP32C6
	default y
	help
	  If enabled, hp & lp voltage can be auto adjusted by PVT characteristic.
	  Otherwise, internal voltage will be set to fixed dbias.
	  This is a must for stable mass production. Disable for debugging only.

menu "Sleep config"

config ESP_SLEEP_RTC_BUS_ISO_WORKAROUND
	bool
	default y if SOC_SERIES_ESP32 || SOC_SERIES_ESP32S2 || SOC_SERIES_ESP32S3

config ESP_SLEEP_GPIO_RESET_WORKAROUND
	bool
	default y if !(SOC_SERIES_ESP32 || SOC_SERIES_ESP32S2)
	help
	  Software workaround for the GPIO ESD reset issue. On wake-up, a GPIO
	  configured input-only that receives a small electrostatic pulse (>6V)
	  during light sleep can trigger a reset. Enabling this configures all
	  GPIO pins to isolate state during sleep.

config ESP_SLEEP_CACHE_SAFE_ASSERTION
	bool
	help
	  Check cache safety in the sleep wake path before flash is ready. For
	  code quality inspection only; adds overhead.

config ESP_SLEEP_GPIO_ENABLE_INTERNAL_RESISTORS
	bool
	default y
	help
	  Allow enabling internal pull-ups/pull-downs for RTC GPIO deep-sleep
	  wakeup IOs when external resistors are absent.

config ESP_SLEEP_ENABLE_RTC_WDT_IN_SLEEP
	bool

config ESP_SLEEP_ENABLE_RTC_WDT_IN_DEEP_SLEEP
	bool

config PM_SLP_DISABLE_GPIO
	bool
	default y if ESP_SLEEP_GPIO_RESET_WORKAROUND
	help
	  Disable GPIO outputs during sleep to reduce leakage. Implied by the GPIO
	  reset workaround.

config PM_CHECK_SLEEP_RETENTION_FRAME
	bool
	help
	  Validate the CPU/peripheral sleep retention frame with a CRC across
	  light sleep. Adds sleep and wake-up overhead, so it is not user
	  selectable and is intended for internal validation only.

config ESP_SLEEP_FLASH_LEAKAGE_WORKAROUND
	bool "Pull up flash CS pin in light sleep"
	depends on SOC_FLASH_ESP32
	default y
	help
	  During light sleep, GPIOs can float. If the flash CS pin is read low,
	  the chip may leak current or see spurious bus activity. This option
	  pulls CS high in sleep. On module designs without an external CS pull-up,
	  keep this enabled.

config ESP_SLEEP_PSRAM_LEAKAGE_WORKAROUND
	bool "Pull up PSRAM CS pin in light sleep"
	depends on ESP_SPIRAM
	default y
	help
	  Same rationale as flash CS, for PSRAM. Enable when using SPIRAM and
	  the CS line is not pulled up externally.

config ESP_SLEEP_MSPI_NEED_ALL_IO_PU
	bool "Pull up all MSPI pins in light sleep"
	depends on ESP_SLEEP_FLASH_LEAKAGE_WORKAROUND || ESP_SLEEP_PSRAM_LEAKAGE_WORKAROUND
	default y if SOC_SERIES_ESP32S3 || SOC_SERIES_ESP32C2
	help
	  Some flash/PSRAM parts need all MSPI lines held in a known state during
	  sleep, not only CS. Enable if your part's datasheet recommends it.

endmenu # Sleep config

endif # SOC_FAMILY_ESPRESSIF_ESP32
```
